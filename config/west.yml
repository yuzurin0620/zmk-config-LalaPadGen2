## config/west.yml
```yaml
manifest:
  remotes:
    - name: zmkfirmware
      url-base: https://github.com/zmkfirmware
    - name: ShiniNet
      url-base: https://github.com/ShiniNet/
    - name: eswai
      url-base: https://github.com/eswai
    - name: caksoylar
      url-base: https://github.com/caksoylar
  projects:
    - name: zmk
      remote: zmkfirmware
      revision: v0.3.0
      import: app/west.yml
    - name: zmk-driver-iqs9151
      remote: ShiniNet
      revision: main
    - name: zmk-easy-charge-indicator
      remote: ShiniNet
      revision: main
    - name: zmk-naginata
      remote: eswai
      revision: main
    - name: zmk-rgbled-widget
      remote: caksoylar
      revision: v0.3
  self:
    path: config
```

## remap_lalapad_tdq/Kconfig
```kconfig
menuconfig ZMK_BEHAVIOR_TAP_DANCE_TRIPLE
    bool "Triple tap-dance behavior"
    default y
    help
      Enable a three-state tap-dance behavior with single tap, single hold,
      and double tap outputs.

if ZMK_BEHAVIOR_TAP_DANCE_TRIPLE

config ZMK_BEHAVIOR_TAP_DANCE_TRIPLE_MAX_HELD
    int "Maximum simultaneous triple tap dances"
    default 10
    help
      Maximum number of active triple tap-dance keys that may be tracked at once.

endif
```

## remap_lalapad_tdq/dts/bindings/behaviors/zmk,behavior-tap-dance-triple.yaml
```yaml
description: Three-state tap-dance behavior
compatible: "zmk,behavior-tap-dance-triple"

include: zero_param.yaml

properties:
  bindings:
    type: phandle-array
    required: true
  tapping-term-ms:
    type: int
    default: 200
```
